## 11-Linux Kernel module basic/03_Integer_And_Character_DD/inetger-base/Kconfig
```kconfig
menu "mgpio device driver"

config MGPIO
    tristate "mgpio device driver"
    depends on ARM
    default y
    help
        Select this option to build the mgpio module.
        If compiled as a module, it will be named mgpio.ko

endmenu
```

## ILI9341/Kconfig
```kconfig
menu "DevLinux: ST7735 Spi Device Driver"

config M7735
        tristate
        prompt "DevLinux: ST7735 SPI Device Driver"
        depends on ARM || ARM64
        default m if ARM || ARM64
        help
           Select this option to run m7735 module.
endmenu
```
